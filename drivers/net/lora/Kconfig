## drivers/net/lora/Kconfig
```kconfig
#
# LoRa
#

menu "LoRa Device Drivers"

config LORA_DEV
	tristate "LoRa drivers"
	default y
	help
	  LoRa ...
	  If unsure, say Y.

#
# Alphabetically sorted.
#

if LORA_DEV

config LORA_MM002
	tristate "Nemeus MM002 driver"
	default y
	depends on SERIAL_DEV_BUS
	help
	  Nemeus MM002

config LORA_RAK811
	tristate "RAK RAK811 driver"
	default y
	depends on SERIAL_DEV_BUS
	help
	  RAK RAK811/RAK812

config LORA_RF1276TS
	tristate "Appcon Wireless RF1276TS driver"
	default y
	depends on SERIAL_DEV_BUS
	help
	  Appcon Wireless RF1276TS LoRaWAN

config LORA_RN2483
	tristate "Microchip RN2483/RN2903 driver"
	default y
	depends on SERIAL_DEV_BUS
	help
	  Microchip RN2483/2903

config LORA_SX125X_CORE
	tristate

config LORA_SX125X
	tristate "Semtech SX125x driver"
	depends on SPI || LORA_SX130X
	help
	  Semtech SX1255/1257 driver

config LORA_SX125X_SPI
	bool "Semtech SX125x SPI driver"
	default n
	depends on LORA_SX125X
	depends on SPI
	select REGMAP_SPI
	select LORA_SX125X_CORE
	help
	  Semtech SX1255/1257 SPI driver

config LORA_SX125X_CON
	bool "Semtech SX125x concentrator driver"
	default y
	depends on LORA_SX125X
	depends on LORA_SX130X
	select REGMAP
	select LORA_SX125X_CORE
	help
	  Semtech SX1255/1257 concentrator driver

config LORA_SX127X
	tristate "Semtech SX127x SPI driver"
	default y
	depends on SPI
	help
	  Semtech SX1272/1276/1278

config LORA_SX130X
	tristate "Semtech SX130x SPI driver"
	default y
	depends on SPI
	select REGMAP_SPI
	help
	  Semtech SX1301/1308

config LORA_TING01M
	tristate "Ting 01M driver"
	default y
	depends on SERIAL_DEV_BUS
	help
	  Himalaya HIMO-01M

config LORA_USI
	tristate "USI WM-SG-SM-42 driver"
	default y
	depends on SERIAL_DEV_BUS
	help
	  USI WM-SG-SM-42

config LORA_WIMOD
	tristate "IMST WiMOD driver"
	default y
	depends on SERIAL_DEV_BUS
	select CRC_CCITT
	help
	  IMST WiMOD

endif

endmenu
```

## net/lora/Kconfig
```kconfig
#
# LoRa
#

menuconfig LORA
	depends on NET
	tristate "LoRa subsystem support"
	help
	  LoRa ...

if LORA

source "drivers/net/lora/Kconfig"

endif
```

## net/lorawan/Kconfig
```kconfig
config LORAWAN
	tristate "LoRaWAN Network support"
	help
	  LoRaWAN defines low data rate, low power and long range wireless
	  wide area networks. It was designed to organize networks of automation
	  devices, such as sensors, switches and actuators. It can operate
	  multiple kilometers wide. The network is client/server technology
	  centered around gateways.

	  Say Y here to compile LoRaWAN support into the kernel or say M to
	  compile it as a module.
```

## net/maclorawan/Kconfig
```kconfig
config MACLORAWAN
	tristate "Generic LoRaWAN Soft Networking Stack (maclorawan)"
	depends on LORAWAN
	select CRYPTO
	select CRYPTO_CMAC
	select CRYPTO_CBC
	select CRYPTO_AES
	help
	  This option enables the hardware independent LoRaWAN
	  networking stack for SoftMAC devices (the ones implementing
	  only PHY level of LoRa standard).

	  If you plan to use HardMAC LoRaWAN devices, you can say N
	  here.  Alternatively you can say M to compile it as a module.
```
